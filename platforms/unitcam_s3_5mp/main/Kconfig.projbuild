## platforms/unitcam_s3_5mp/main/Kconfig.projbuild
```kconfig
menu "Picsaver (SD JPEG)"

config PICSAVER_ENCRYPTION_PASSWORD
    string "Passphrase for AES-256-GCM file encryption"
    default ""
    help
        If non-empty, each JPEG is encrypted before writing; filenames use the .ucam suffix.
        Leave empty to save normal .jpg files.
        The same passphrase is used with tools/decrypt_ucam.py on your PC.
        Note: the passphrase is stored in firmware image and sdkconfig — not secret from someone with flash access.

endmenu
```

## platforms/unitcam_s3_5mp/sdkconfig.defaults
```kconfig
# Arduino-ESP32 requires 1 kHz tick (see components/arduino-esp32/CMakeLists.txt)
CONFIG_FREERTOS_HZ=1000

# UnitCam S3 5MP — MEGA_CCM sensor at I2C 0x1f (esp32-camera driver)
CONFIG_MEGA_CCM_SUPPORT=y

# JPEG DMA uses ~5 MB frame buffer (2592x1944) in PSRAM — required on S3
CONFIG_ESP32S3_SPIRAM_SUPPORT=y
CONFIG_SPIRAM=y
CONFIG_SPIRAM_MODE_OCT=y
CONFIG_SPIRAM_TYPE_AUTO=y
CONFIG_SPIRAM_CLK_IO=30
CONFIG_SPIRAM_CS_IO=26
CONFIG_SPIRAM_SPEED_40M=y
CONFIG_SPIRAM_BOOT_INIT=y
CONFIG_SPIRAM_USE_MALLOC=y
CONFIG_SPIRAM_MEMTEST=y
CONFIG_SPIRAM_MALLOC_ALWAYSINTERNAL=16384
CONFIG_SPIRAM_MALLOC_RESERVE_INTERNAL=32768

# FAT long filenames (folder + timestamped .jpg names exceed 8.3)
CONFIG_FATFS_LFN_HEAP=y
CONFIG_FATFS_MAX_LFN=255
# Standard microSD + Windows FAT32 use 512-byte sectors; 4096 is for on-chip flash.
CONFIG_FATFS_SECTOR_512=y

# Only SPI + FS + SD (SD card). Skips ESP_I2S (needs mp3dec), WiFi, BLE, RainMaker, etc.
CONFIG_ARDUINO_SELECTIVE_COMPILATION=y
CONFIG_ARDUINO_SELECTIVE_SPI=y
CONFIG_ARDUINO_SELECTIVE_FS=y
CONFIG_ARDUINO_SELECTIVE_SD=y
# CONFIG_ARDUINO_SELECTIVE_Wire is not set
# CONFIG_ARDUINO_SELECTIVE_EEPROM is not set
# CONFIG_ARDUINO_SELECTIVE_Preferences is not set
# CONFIG_ARDUINO_SELECTIVE_Ticker is not set
# CONFIG_ARDUINO_SELECTIVE_Update is not set
# CONFIG_ARDUINO_SELECTIVE_SD_MMC is not set
# CONFIG_ARDUINO_SELECTIVE_SPIFFS is not set
# CONFIG_ARDUINO_SELECTIVE_FFat is not set
# CONFIG_ARDUINO_SELECTIVE_LittleFS is not set
# CONFIG_ARDUINO_SELECTIVE_Network is not set
# CONFIG_ARDUINO_SELECTIVE_Ethernet is not set
# CONFIG_ARDUINO_SELECTIVE_PPP is not set
# CONFIG_ARDUINO_SELECTIVE_ArduinoOTA is not set
# CONFIG_ARDUINO_SELECTIVE_AsyncUDP is not set
# CONFIG_ARDUINO_SELECTIVE_DNSServer is not set
# CONFIG_ARDUINO_SELECTIVE_ESPmDNS is not set
# CONFIG_ARDUINO_SELECTIVE_HTTPClient is not set
# CONFIG_ARDUINO_SELECTIVE_NetBIOS is not set
# CONFIG_ARDUINO_SELECTIVE_WebServer is not set
# CONFIG_ARDUINO_SELECTIVE_WiFi is not set
# CONFIG_ARDUINO_SELECTIVE_NetworkClientSecure is not set
# CONFIG_ARDUINO_SELECTIVE_WiFiProv is not set
# CONFIG_ARDUINO_SELECTIVE_BLE is not set
# CONFIG_ARDUINO_SELECTIVE_BluetoothSerial is not set
# CONFIG_ARDUINO_SELECTIVE_SimpleBLE is not set

# Optional JPEG encryption (see README). Empty = plain .jpg on SD.
CONFIG_PICSAVER_ENCRYPTION_PASSWORD=""
```
